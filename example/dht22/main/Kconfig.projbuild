## example/dht22/main/Kconfig.projbuild
```kconfig
menu "DHT Configuration"

choice "Select DHT Sensor Type"
    prompt "Select the type of DHT sensor used in your project"
    default EXAMPLE_TYPE_AM2301

    config EXAMPLE_TYPE_DHT11
        bool "DHT11"

    config EXAMPLE_TYPE_AM2301
        bool "DHT21/DHT22/AM2301/AM2302/AM2321"

    config EXAMPLE_TYPE_SI7021
        bool "Itead Si7021"
endchoice

config ESP_TEMP_SENSOR_GPIO
    int "GPIO Number for DHT Data Pin"
    default 4 if IDF_TARGET_ESP8266 || IDF_TARGET_ESP32C3 || IDF_TARGET_ESP32C2 || IDF_TARGET_ESP32C6
    default 17 if IDF_TARGET_ESP32 || IDF_TARGET_ESP32S2 || IDF_TARGET_ESP32S3
    help
        Specify the GPIO number to which the DHT sensor data pin is connected.

endmenu
```
